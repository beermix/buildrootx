## package/checksec/Config.in.host
```kconfig
config BR2_PACKAGE_HOST_CHECKSEC
	bool "host checksec"
	help
	  This tool provides a shell script to check the
	  properties of the executables
	  (like PIE,RELRO,PaX,Canaries,ASLR,Fortify Source).

	  https://github.com/slimm609/checksec.sh.git

	  NOTE: This tool has a hard-coded path to the standard
	  libraries for some of the fortify test cases and
	  requires you to either test the local filesystem or be
	  in a chroot'd environment.  The tool can still be used
	  against a folder of files but requires discretion of
	  which the tests may not report consistently vs
	  chroot/on-target.
```

## package/chromium/Config.in
```kconfig
config BR2_PACKAGE_CHROMIUM
	bool "chromium"
	depends on BR2_PACKAGE_HAS_LIBGL
	depends on BR2_PACKAGE_XORG7
	depends on BR2_TOOLCHAIN_USES_GLIBC
	depends on BR2_arm || BR2_aarch64 || BR2_i386 || BR2_x86_64
	select BR2_PACKAGE_ALSA_LIB
	select BR2_PACKAGE_CUPS
	select BR2_PACKAGE_DBUS
	select BR2_PACKAGE_FREETYPE
	select BR2_PACKAGE_HARFBUZZ
	select BR2_PACKAGE_LLVM_ENABLE_HOST_ARCH
	select BR2_PACKAGE_HOST_CLANG
	select BR2_PACKAGE_HOST_LLD
	select BR2_PACKAGE_HOST_NINJA
	select BR2_PACKAGE_HOST_NODEJS
	select BR2_PACKAGE_HOST_PYTHON
	select BR2_PACKAGE_JPEG_TURBO
	select BR2_PACKAGE_LIBDRM
	select BR2_PACKAGE_LIBERATION # runtime
	select BR2_PACKAGE_LIBGLIB2
	select BR2_PACKAGE_LIBGTK2 if !BR2_PACKAGE_LIBGTK3_X11
	select BR2_PACKAGE_LIBKRB5
	select BR2_PACKAGE_LIBNSS
	select BR2_PACKAGE_LIBPNG
	select BR2_PACKAGE_PCIUTILS
	select BR2_PACKAGE_XLIB_LIBXCOMPOSITE
	select BR2_PACKAGE_XLIB_LIBXCURSOR
	select BR2_PACKAGE_XLIB_LIBXI if !BR2_PACKAGE_LIBGTK3_X11
	select BR2_PACKAGE_XLIB_LIBXRANDR
	select BR2_PACKAGE_XLIB_LIBXSCRNSAVER
	select BR2_PACKAGE_XLIB_LIBXTST if !BR2_PACKAGE_LIBGTK3_X11

config BR2_PACKAGE_CHROMIUM_TARGET_ARCH
	string
	default "arm" if BR2_arm
	default "arm64" if BR2_aarch64
	default "x86" if BR2_i386
	default "x64" if BR2_x86_64
	default "mips" if BR2_mips

comment "chromium needs toolchain w/ Glibc"
	depends on !BR2_TOOLCHAIN_USES_GLIBC

comment "chromium depends on X.org and needs an OpenGL backend"
	depends on !BR2_PACKAGE_XORG7 || !BR2_PACKAGE_HAS_LIBGL
```

## package/compilerrt/Config.in.host
```kconfig
config BR2_PACKAGE_HOST_COMPILERRT
	bool "host compilerrt"
	depends on BR2_PACKAGE_LLVM_ARCH_SUPPORTS # llvm
	depends on BR2_HOST_GCC_AT_LEAST_4_8 # llvm
	select BR2_PACKAGE_HOST_LLVM
	help
	  COMPILERRT

	  https://compiler-rt.llvm.org/

comment "compilerrt needs a toolchain w/ host gcc >= 4.8"
	depends on BR2_PACKAGE_LLVM_ARCH_SUPPORTS
	depends on !BR2_HOST_GCC_AT_LEAST_4_8
```
